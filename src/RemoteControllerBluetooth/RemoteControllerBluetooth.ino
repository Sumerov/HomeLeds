/* Setup of OLED display*/
#include <Adafruit_GFX.h>
#include <Adafruit_SSD1306.h>
#define SCREEN_WIDTH 128 /*128 width of OLED in pixels*/
#define SCREEN_HEIGHT 32 /*64 height of OLED in pixels*/
Adafruit_SSD1306 display(SCREEN_WIDTH, SCREEN_HEIGHT, &Wire, -1); /*OLED display connected at I2C pins (SDA, SCL)*/

/* Setup of bluetooth module */
#include <Wire.h>
#define RX 0
#define TX 1
#define HC05EN A0
#define COUNTERLIMIT 20
#include <SoftwareSerial.h>
SoftwareSerial bluetooth(TX, RX); 

/* Arduinos IDs of buttons */
#define BUTTONSCOUNT 11
int buttons[BUTTONSCOUNT] = { 11, 12, 2, 9, 3, 8, 4, 7, 5, 10, 6};
bool buttonsStatus[BUTTONSCOUNT];
bool buttonsStatusOld[BUTTONSCOUNT];

// 'Logo Hella', 128x32px
const unsigned char epd_bitmap_Logo_Hella [] PROGMEM = {
	0x00, 0x00, 0x00, 0x00, 0x00, 0x00, 0x00, 0x06, 0x07, 0x00, 0x00, 0x04, 0x00, 0x00, 0x00, 0x00, 
	0x3f, 0x1f, 0xcf, 0xc7, 0xc0, 0x00, 0x3f, 0xfe, 0x7f, 0xf1, 0xff, 0xf7, 0x81, 0xff, 0x07, 0xc0, 
	0x7f, 0x9f, 0xcf, 0xcf, 0xe0, 0x00, 0x3f, 0xfe, 0x7f, 0xf8, 0xff, 0xf3, 0x81, 0xef, 0x07, 0xe0, 
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	0x00, 0x00, 0x00, 0x00, 0x00, 0x00, 0x00, 0x00, 0x00, 0x00, 0x00, 0x00, 0x00, 0x00, 0x00, 0x00
};

void setup() {
	for(uint8_t i=0; i < BUTTONSCOUNT; i++) {
		pinMode( buttons[i], INPUT ); 
		buttonsStatus[i] = false;
		buttonsStatusOld[i] = false;
	}
	pinMode(HC05EN, OUTPUT);
	digitalWrite(HC05EN, HIGH);
    //Serial.begin(9600);  /*Baud rate UART communication */
    bluetooth.begin(9600);
	bluetooth.println("---------------------------------------------------------");
  	bluetooth.println("Lachtrup box - CAN exersizer");
  	bluetooth.println("Bluetooth remote control");
  	bluetooth.println("Created by J. Retych");
  	bluetooth.println("---------------------------------------------------------");
  	bluetooth.println("for help, please send letter: h");
  	bluetooth.println("---------------------------------------------------------");
    if(!display.begin(SSD1306_SWITCHCAPVCC, 0x3C)) { /*I2C Address at which OLED will communicate*/
        Serial.println(F("SSD1306 allocation failed"));
        for(;;);
    }
    display.clearDisplay();  /*Clear display*/
    delay(20);
    display.drawBitmap(0, 0, epd_bitmap_Logo_Hella, 128, 32, WHITE);
    display.display();
	delay(500);
}

void readButtonsState() {
	for(uint8_t i=0; i < BUTTONSCOUNT; i++) {
		buttonsStatus[i] = digitalRead(buttons[i]);
	}
}

void printButtonsState() {
			
	for(uint8_t i=0; i < BUTTONSCOUNT; i++) {
			if(buttonsStatus[i]) {
				display.clearDisplay();
				display.display();
				display.setTextSize(2);
				display.setTextColor(WHITE);
				display.setCursor(0,0);
				display.print("(");
				display.print(i);
				display.print("): ");
				display.print(buttonsStatus[i]);
				display.print("|");
				buttonsStatusOld[i] = buttonsStatus[i];
				display.display();
				delay(1000);
			}

	}
}

void loop() {
	readButtonsState();
	printButtonsState();
    byte BluetoothData;
        //bluetooth.print("read: "); 
    if (bluetooth.available() > 0) {
        BluetoothData=bluetooth.read();
        bluetooth.print("read: ");   
        bluetooth.println(BluetoothData);
    }
    delay(100);
}